## drivers/vfio/mdev/Kconfig
```kconfig
config VFIO_MDEV
    tristate "Mediated device driver framework"
    depends on VFIO
    default n
    help
        Provides a framework to virtualize devices.
	See Documentation/vfio-mdev/vfio-mediated-device.txt for more details.

        If you don't know what do here, say N.
```
